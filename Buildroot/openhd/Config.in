## Buildroot/openhd/Config.in
```kconfig
config BR2_PACKAGE_OPENHD
    bool "openhd"
    select BR2_PACKAGE_LIBPCAP
    select BR2_PACKAGE_LIBSODIUM
    select BR2_PACKAGE_GSTREAMER1
    select BR2_PACKAGE_GST1_PLUGINS_BASE
	  select BR2_PACKAGE_GST1_PLUGINS_BASE_PLUGIN_APP

    help
      OpenHD package
```
